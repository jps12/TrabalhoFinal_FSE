## distributed-server/src/Kconfig.projbuild
```kconfig
menu "Configuração do Wifi"

config ESP_WIFI_SSID
    string "WiFi SSID"
    default "ssid"
    help
        Nome da rede Wifi.

config ESP_WIFI_PASSWORD
    string "Senha do Wifi"
    default "minha_senha"
    help
        Senha do WiFi (WPA or WPA2).

config ESP_MAXIMUM_RETRY
    int "Número máximo de tentativas de conexão"
    default 5
    help
        Configure o valor máximo de tentativas de conexão.
endmenu

menu "Configuração Low Power"

config LOW_POWER_ENABLE
    int "Modo Low Power"
    default 0
    help
        Ativar modo low Power da ESP
endmenu

menu "Configuração MQTT"

config URL_BROKER_MQTT
    string "URL do broker MQTT"
    default "mqtt://broker.emqx.io"
    help
        Configurar url do protocolo mqtt usado
endmenu
```
